// SPDX-License-Identifier: GPL-2.0
// Copyright (c) 2014-2015, The Linux Foundation. All rights reserved.
// Copyright (c) 2024, Benarji Anand <benarji385@gmail.com>

#include "msm8976-pmi8950.dtsi"
