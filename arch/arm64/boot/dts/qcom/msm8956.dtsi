// SPDX-License-Identifier: GPL-2.0
// Copyright (c) 2014-2019, The Linux Foundation. All rights reserved.
// Copyright (c) 2023-2024, Benarji Anand <benarji385@gmail.com>

#include "msm8976.dtsi"

/ {
	model = "Qualcomm Technologies, Inc. MSM8956";
	compatible = "qcom,msm8956";
	qcom,msm-id = <266 0x0>;
};
