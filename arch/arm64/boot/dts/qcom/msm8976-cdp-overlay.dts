// SPDX-License-Identifier: GPL-2.0
// Copyright (c) 2015, The Linux Foundation. All rights reserved.
// Copyright (c) 2024, Benarji Anand <benarji385@gmail.com>

/dts-v1/;
/plugin/;

#include "msm8976-cdp.dtsi"

/ {
        model = "Qualcomm Technologies, Inc. MSM8976 CDP";
        compatible = "qcom,msm8976-cdp", "qcom,msm8976", "qcom,cdp";
        qcom,board-id = <1 0>;
};

